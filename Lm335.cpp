//#include "WProgram.h"
#include "Arduino.h"
#include <Lm335.h>

void Lm335::datchikVozdAnalog()  // Функция получения данных с аналогового датчика температуры
{ 
  for (int i=0; i<20; i=i+1)     // Цикл считывания 20 раз через 20мс данных с датчика и записи их в массив
  {
    izmer[i]=analogRead(_Temper_A);
    //delay(20);
  }
  
  for (int j=19; j>=0; j=j-1)   // Сортировка данных в массиве в порядке возрастания
  {
    for (int i=0; i<j; i=i+1)
    {
            
      if(izmer[i]>izmer[i+1])
      {
        temp=izmer[i];
        izmer[i]=izmer[i+1];
        izmer[i+1]=temp;
      }
    }
  }

  /* Для дальнейших расчетов отбрасываеим 2 максимальных и 2 минимальных
     значения из массива, так как они могут сильно отличаться и повлиять на точность
     измерения*/
  temp=0;
  for (int i=2; i<18; i=i+1)   // для оставшихся 16-ти значений находим среднее арифметическое
  {
    temp=temp+izmer[i];
  }
  temp=temp/16;
  volt335=temp*_voltVcc/1024;     /* Здесь _voltVcc - опорное напряжение. 
  Устанавливаем его в скетче (см. пример), тогда датчик покажет правильно
  volt335 должно при 25 градусов быть около 2.98-3.00 вольта */
  
  // Температуру из шкалы Кельвина переводим в градусы по Цельсию:
  temp335=volt335*100-273.15;

  /* Поскольку температура с точностью 0,01 нам не нужна, да и она
     не имеет смысла, так как точность датчика 0.5В, округляем ее
     до целых значений: */
  temp335_out=int(temp335);
  if((temp335-temp335_out) >= 0.5)
  {
    temp335_out=temp335_out+1;
  }
  
}

Lm335::Lm335(int Temper_A,double voltVcc) // Конструктор
{
  _Temper_A=Temper_A;
  _voltVcc=voltVcc;
}

